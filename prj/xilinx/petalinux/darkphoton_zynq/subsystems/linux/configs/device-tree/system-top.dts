/dts-v1/;
/include/ "system-conf.dtsi"
/ {
};

&spi1 {
	is-decoded-cs = <0>;
	num-cs = <1>;
	status = "okay";
	spi-max-frequency = <25000000>;
	spidev@0x00 {
		compatible = "spidev";
		spi-max-frequency = <25000000>;
		reg = <0>;
	};
};

